## west.yml
```yaml
# Copyright (c) 2024-2026 O.S. Systems Software LTDA.
# Copyright (c) 2024-2026 Freedom Veiculos Eletricos
# SPDX-License-Identifier: Apache-2.0

manifest:
  defaults:
    remote: ossystems

  remotes:
    - name: zephyrproject-rtos
      url-base: https://github.com/zephyrproject-rtos
    - name: ossystems
      url-base: git@github.com:OSSystems
    - name: rodrigopex
      url-base: https://github.com/rodrigopex

  projects:
    - name: zephyr
      remote: zephyrproject-rtos
      revision: 0534e997eacb94bae1df6c9a7dd4a9a6cbf1cecf # main
      import:
        path-prefix: deps
        path-allowlist:
          - modules/hal/cmsis_6
          - modules/hal/stm32
    - name: lua_zephyr
      remote: rodrigopex
      revision: 66fc52fdf36a5c8c9e30addf0b829be3714f3c48 # main
      path: deps/modules/lib/lua_zephyr
      submodules: true

  self:
    import:
```
