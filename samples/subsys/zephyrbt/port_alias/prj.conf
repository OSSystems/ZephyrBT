## CMakeLists.txt
```
# Copyright (c) 2026 O.S. Systems Software LTDA.
# Copyright (c) 2026 Freedom Veiculos Eletricos
# SPDX-License-Identifier: Apache-2.0

cmake_minimum_required(VERSION 3.20.0)

find_package(Zephyr REQUIRED HINTS $ENV{ZEPHYR_BASE})
include(${ZEPHYR_ZEPHYRBT_MODULE_DIR}/cmake/zephyrbt-from-behaviourtreecpp-xml.cmake)

project(zephyrbt_port_alias)

target_sources(app PRIVATE
	src/main.c
	src/port_alias.c
)

zephyrbt_define_from_behaviourtreecpp_xml(app
	models/port_alias.xml
	${CMAKE_BINARY_DIR}/include
	${CMAKE_BINARY_DIR}/src
	1024
	0
	yes
)
```

## sample.yaml
```
# Copyright (c) 2026 O.S. Systems Software LTDA.
# Copyright (c) 2026 Freedom Veiculos Eletricos
# SPDX-License-Identifier: Apache-2.0

sample:
  name: Zephyr Behaviour Tree - Port Alias (Issue #40)
  description: |
    This sample validates that multiple instances of the same node type with
    different port bindings get distinct blackboard references. It reproduces
    the scenario from issue #40 where the code generator assigned all instances
    the same blackboard ref due to shared entry objects.

    This test uses random to create the initial value and uses the special
    test_port_alias.py to validate the qemu_cortex_m3.
common:
  tags: zephyrbt
tests:
  samples.zephyrbt.port_alias:
    platform_allow:
      - qemu_cortex_m3
      - nucleo_f767zi
    harness: pytest
    harness_config:
      pytest_root:
        - "pytest"
```

## prj.conf
```kconfig
# Copyright (c) 2026 O.S. Systems Software LTDA.
# Copyright (c) 2026 Freedom Veiculos Eletricos
# SPDX-License-Identifier: Apache-2.0

CONFIG_LOG=y
CONFIG_LOG_MODE_MINIMAL=y

CONFIG_ZEPHYR_BEHAVIOUR_TREE=y
CONFIG_ZEPHYR_BEHAVIOUR_TREE_DYNAMIC=y
CONFIG_ZEPHYR_BEHAVIOUR_TREE_NODE_INFO=y
CONFIG_ZEPHYR_BEHAVIOUR_TREE_NODE_INIT=y
CONFIG_ZEPHYR_BEHAVIOUR_TREE_NODE_CONTEXT=y
CONFIG_ZEPHYR_BEHAVIOUR_TREE_LOG_LEVEL_DBG=y

CONFIG_DYNAMIC_THREAD=y
CONFIG_DYNAMIC_THREAD_POOL_SIZE=10
CONFIG_THREAD_STACK_INFO=y

CONFIG_KERNEL_MEM_POOL=y
CONFIG_HEAP_MEM_POOL_SIZE=8192

CONFIG_TEST_RANDOM_GENERATOR=y
```

## src/port_alias.c
```c
/*
 * Copyright (c) 2026 O.S. Systems Software LTDA.
 * Copyright (c) 2026 Freedom Veiculos Eletricos
 *
 * SPDX-License-Identifier: Apache-2.0
 */

#include <stdint.h>
#include <zephyr/random/random.h>
#include <zephyr/zephyrbt/zephyrbt.h>

#include <zephyr/logging/log.h>
LOG_MODULE_REGISTER(port_alias, CONFIG_ZEPHYR_BEHAVIOUR_TREE_LOG_LEVEL);

#include "port_alias.h"

enum zephyrbt_child_status zephyrbt_action_write_value_init(struct zephyrbt_context *ctx,
							    struct zephyrbt_node *self)
{
	struct zephyrbt_blackboard_item *item = zephyrbt_search_blackboard(
		ctx, self->index, ZEPHYRBT_WRITE_VALUE_ATTRIBUTE_VALUE_PORT);
	if (!item) {
		LOG_ERR("write_value [%d]: blackboard item not found", self->index);
		return ZEPHYRBT_CHILD_FAILURE_STATUS;
	}

	uint32_t counter = sys_rand32_get();

	/*
	 * Set initial value
	 */
	item->item = (zephyrbt_node_context_t)counter;

	/*
	 * When using CONFIG_ZEPHYR_BEHAVIOUR_TREE_NODE_CONTEXT=y it is possible
	 * to initialize the blackboard item index to avoid runtime search.
	 *
	 * Use self->ctx to point to blackboard item.
	 */
	self->ctx = &item->item;

	LOG_INF("initial value [%d]: wrote %u", self->index, counter);

	return ZEPHYRBT_CHILD_SUCCESS_STATUS;
}

enum zephyrbt_child_status zephyrbt_action_write_value(struct zephyrbt_context *ctx,
						       struct zephyrbt_node *self)
{
	/*
	 * The zephyrbt_action_FOO_init already makes the checks to ensure that
	 * the value available. This means that at runtime action can ignore
	 * checks to speed up the tree.
	 */
	uint32_t *counter = (uint32_t *)self->ctx;

	(*counter)++;

	LOG_INF("write_value [%d]: wrote %u", self->index, *counter);

	return ZEPHYRBT_CHILD_SUCCESS_STATUS;
}

enum zephyrbt_child_status zephyrbt_action_read_value_init(struct zephyrbt_context *ctx,
							   struct zephyrbt_node *self)
{
	struct zephyrbt_blackboard_item *item = zephyrbt_search_blackboard(
		ctx, self->index, ZEPHYRBT_READ_VALUE_ATTRIBUTE_VALUE_PORT);
	if (!item) {
		LOG_ERR("write_value [%d]: blackboard item not found", self->index);
		return ZEPHYRBT_CHILD_FAILURE_STATUS;
	}

	self->ctx = &item->item;

	return ZEPHYRBT_CHILD_SUCCESS_STATUS;
}

enum zephyrbt_child_status zephyrbt_action_read_value(struct zephyrbt_context *ctx,
						      struct zephyrbt_node *self)
{
	uint32_t *counter = (uint32_t *)self->ctx;

	LOG_INF("read_value [%d]: read %u", self->index, *counter);

	return ZEPHYRBT_CHILD_SUCCESS_STATUS;
}
```
