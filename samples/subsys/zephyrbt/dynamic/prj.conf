## CMakeLists.txt
```
# Copyright (c) 2024-2025 O.S. Systems Software LTDA.
# Copyright (c) 2024-2025 Freedom Veiculos Eletricos
# SPDX-License-Identifier: Apache-2.0

cmake_minimum_required(VERSION 3.20.0)

find_package(Zephyr REQUIRED HINTS $ENV{ZEPHYR_BASE})
include(${ZEPHYR_ZEPHYRBT_MODULE_DIR}/cmake/zephyrbt-from-behaviourtreecpp-xml.cmake)

project(zephyrbt_dynamic)

zephyr_include_directories(
	${CMAKE_CURRENT_SOURCE_DIR}/include
)

target_sources(app PRIVATE
	src/main.c
)

zephyrbt_define_from_behaviourtreecpp_xml(app
	models/lc_rs_bt.xml
	${CMAKE_BINARY_DIR}/include
	${CMAKE_BINARY_DIR}/src
	1024
	0
	yes
)

zephyrbt_define_from_behaviourtreecpp_xml(app
	models/modelo.xml
	${CMAKE_BINARY_DIR}/include
	${CMAKE_BINARY_DIR}/src
	1024
	0
	yes
)
```

## sample.yaml
```
# Copyright (c) 2024-2025 O.S. Systems Software LTDA.
# Copyright (c) 2024-2025 Freedom Veiculos Eletricos
# SPDX-License-Identifier: Apache-2.0

sample:
  name: Zephyr Behaviour Tree - Dynamic
common:
  tags: zephyrbt
tests:
  samples.zephyrbt.dynamic:
    platform_allow:
      - qemu_cortex_m3
      - nucleo_f767zi
    harness: console
    harness_config:
      type: multi_line
      regex:
        - "D: init: delay \\[decorator, 13\\]"
        - "D: tick"
        - "D: eval delay \\[decorator, 13\\]"
        - "D: Deep: 1"
        - "D: delay \\[decorator, 13\\]"
        - "D: init: delay \\[decorator, 19\\]"
        - "D: zephyrbt_condition_ball_found_init stub function"
        - "D: zephyrbt_action_find_ball_init stub function"
        - "D: zephyrbt_condition_ball_close_init stub function"
        - "D: zephyrbt_action_approch_ball_init stub function"
        - "D: zephyrbt_condition_ball_grasped_init stub function"
        - "D: zephyrbt_action_grasp_ball_init stub function"
        - "D: zephyrbt_condition_bin_close_init stub function"
        - "D: zephyrbt_action_approch_bin_init stub function"
        - "D: zephyrbt_condition_ball_placed_init stub function"
        - "D: zephyrbt_action_place_ball_init stub function"
        - "D: init: timeout \\[decorator, 1\\]"
        - "D: zephyrbt_action_ask_for_help_init stub function"
        - "D: tick"
        - "D: eval delay \\[decorator, 19\\]"
        - "D: Deep: 1"
        - "D: delay \\[decorator, 19\\]"
        - "D: eval A \\[control, 12\\]"
        - "D: Deep: 2"
        - "D: A \\[control, 12\\]"
        - "D: eval B \\[control, 11\\]"
        - "D: Deep: 3"
        - "D: B \\[control, 11\\]"
        - "D: eval F \\[control, 10\\]"
        - "D: Deep: 4"
        - "D: F \\[control, 10\\]"
        - "D: eval I \\[action, 9\\]"
        - "D: Deep: 5"
        - "D: I \\[action, 9\\]"
        - "D: eval J \\[action, 8\\]"
        - "D: Deep: 5"
        - "D: J \\[action, 8\\]"
        - "D: eval K \\[action, 7\\]"
        - "D: Deep: 5"
        - "D: K \\[action, 7\\]"
        - "D: eval G \\[action, 6\\]"
        - "D: Deep: 4"
        - "D: G \\[action, 6\\]"
        - "D: eval C \\[action, 5\\]"
        - "D: Deep: 3"
        - "D: C \\[action, 5\\]"
        - "D: eval D \\[control, 4\\]"
        - "D: Deep: 3"
        - "D: D \\[control, 4\\]"
        - "D: eval H \\[control, 3\\]"
        - "D: Deep: 4"
        - "D: H \\[control, 3\\]"
        - "D: eval L \\[action, 2\\]"
        - "D: Deep: 5"
        - "D: L \\[action, 2\\]"
        - "D: eval M \\[action, 1\\]"
        - "D: Deep: 5"
        - "D: M \\[action, 1\\]"
        - "D: eval E \\[action, 0\\]"
        - "D: Deep: 3"
        - "D: E \\[action, 0\\]"
        - "D: tick"
        - "D: eval delay \\[decorator, 13\\]"
        - "D: Deep: 1"
        - "D: delay \\[decorator, 13\\]"
        - "D: eval fallback \\[control, 18\\]"
        - "D: Deep: 2"
        - "D: fallback \\[control, 18\\]"
        - "D: eval sequence \\[control, 17\\]"
        - "D: Deep: 3"
        - "D: sequence \\[control, 17\\]"
        - "D: eval fallback \\[control, 16\\]"
        - "D: Deep: 4"
        - "D: fallback \\[control, 16\\]"
        - "D: eval ball_found \\[condition, 15\\]"
        - "D: Deep: 5"
        - "D: zephyrbt_condition_ball_found stub function"
        - "D: eval fallback \\[control, 13\\]"
        - "D: Deep: 4"
        - "D: fallback \\[control, 13\\]"
        - "D: eval ball_close \\[condition, 12\\]"
        - "D: Deep: 5"
        - "D: zephyrbt_condition_ball_close stub function"
        - "D: eval fallback \\[control, 10\\]"
        - "D: Deep: 4"
        - "D: fallback \\[control, 10\\]"
        - "D: eval ball_grasped \\[condition, 9\\]"
        - "D: Deep: 5"
        - "D: zephyrbt_condition_ball_grasped stub function"
        - "D: eval fallback \\[control, 7\\]"
        - "D: Deep: 4"
        - "D: fallback \\[control, 7\\]"
        - "D: eval bin_close \\[condition, 6\\]"
        - "D: Deep: 5"
        - "D: zephyrbt_condition_bin_close stub function"
        - "D: eval fallback \\[control, 4\\]"
        - "D: Deep: 4"
        - "D: fallback \\[control, 4\\]"
        - "D: eval ball_placed \\[condition, 3\\]"
        - "D: Deep: 5"
        - "D: zephyrbt_condition_ball_placed stub function"
        - "D: tick"
        - "D: eval delay \\[decorator, 19\\]"
        - "D: Deep: 1"
        - "D: delay \\[decorator, 19\\]"
        - "D: eval A \\[control, 12\\]"
        - "D: Deep: 2"
        - "D: A \\[control, 12\\]"
        - "D: eval B \\[control, 11\\]"
        - "D: Deep: 3"
        - "D: B \\[control, 11\\]"
        - "D: eval F \\[control, 10\\]"
        - "D: Deep: 4"
        - "D: F \\[control, 10\\]"
        - "D: eval I \\[action, 9\\]"
        - "D: Deep: 5"
        - "D: I \\[action, 9\\]"
        - "D: eval J \\[action, 8\\]"
        - "D: Deep: 5"
        - "D: J \\[action, 8\\]"
        - "D: eval K \\[action, 7\\]"
        - "D: Deep: 5"
        - "D: K \\[action, 7\\]"
        - "D: eval G \\[action, 6\\]"
        - "D: Deep: 4"
        - "D: G \\[action, 6\\]"
        - "D: eval C \\[action, 5\\]"
        - "D: Deep: 3"
        - "D: C \\[action, 5\\]"
        - "D: eval D \\[control, 4\\]"
        - "D: Deep: 3"
        - "D: D \\[control, 4\\]"
        - "D: eval H \\[control, 3\\]"
        - "D: Deep: 4"
        - "D: H \\[control, 3\\]"
        - "D: eval L \\[action, 2\\]"
        - "D: Deep: 5"
        - "D: L \\[action, 2\\]"
        - "D: eval M \\[action, 1\\]"
        - "D: Deep: 5"
        - "D: M \\[action, 1\\]"
        - "D: eval E \\[action, 0\\]"
        - "D: Deep: 3"
        - "D: E \\[action, 0\\]"
```

## prj.conf
```kconfig
# Copyright (c) 2024 O.S. Systems Software LTDA.
# Copyright (c) 2024 Freedom Veiculos Eletricos
# SPDX-License-Identifier: Apache-2.0

CONFIG_LOG=y
CONFIG_LOG_MODE_MINIMAL=y

CONFIG_ZEPHYR_BEHAVIOUR_TREE=y
CONFIG_ZEPHYR_BEHAVIOUR_TREE_DYNAMIC=y
CONFIG_ZEPHYR_BEHAVIOUR_TREE_NODE_INFO=y
CONFIG_ZEPHYR_BEHAVIOUR_TREE_NODE_INIT=y
CONFIG_ZEPHYR_BEHAVIOUR_TREE_NODE_CONTEXT=y
CONFIG_ZEPHYR_BEHAVIOUR_TREE_LOG_LEVEL_DBG=y

CONFIG_DYNAMIC_THREAD=y
CONFIG_DYNAMIC_THREAD_POOL_SIZE=10
CONFIG_THREAD_STACK_INFO=y

CONFIG_KERNEL_MEM_POOL=y
CONFIG_HEAP_MEM_POOL_SIZE=8192
```

## src/main.c
```c
/*
 * Copyright (c) 2024 O.S. Systems Software LTDA.
 * Copyright (c) 2024 Freedom Veiculos Eletricos
 *
 * SPDX-License-Identifier: Apache-2.0
 */

#include <zephyr/kernel.h>

int main(void)
{
	return 0;
}
```

## include/zephyrbt_user.h
```c
/*
 * Copyright (c) 2024 O.S. Systems Software LTDA.
 * Copyright (c) 2024 Freedom Veiculos Eletricos
 *
 * SPDX-License-Identifier: Apache-2.0
 */

#ifndef ZEPHYRBT_USER_H
#define ZEPHYRBT_USER_H

#endif /* ZEPHYRBT_USER_H */
```
