## CMakeLists.txt
```
# Copyright (c) 2026 O.S. Systems Software LTDA.
# Copyright (c) 2026 Freedom Veiculos Eletricos
# SPDX-License-Identifier: Apache-2.0

cmake_minimum_required(VERSION 3.20.0)

find_package(Zephyr REQUIRED HINTS $ENV{ZEPHYR_BASE})
include(${ZEPHYR_ZEPHYRBT_MODULE_DIR}/cmake/zephyrbt-from-behaviourtreecpp-xml.cmake)

project(zephyrbt_robot_patrol)

zephyr_include_directories(
    ${CMAKE_CURRENT_SOURCE_DIR}/include
)

target_sources(app PRIVATE
    src/main.c
    src/world.c
    src/navigation.c
    src/waypoint.c
    src/scan.c
    src/emergency.c
    src/charge.c
    src/lua_scripts.c
    src/display.c
)

if(NOT CONFIG_NATIVE_APPLICATION)
    target_sources(app PRIVATE src/posix_stubs.c)
endif()

zephyrbt_define_from_behaviourtreecpp_xml(app
    models/robot_patrol.xml
    ${CMAKE_BINARY_DIR}/include
    ${CMAKE_BINARY_DIR}/src
    8192
    0
    yes
)

# User Lua files (strong overrides, loaded before generated).
# diagnostics.lua is loaded first since others depend on manhattan().
zephyrbt_add_lua_file(app lua/diagnostics.lua)
zephyrbt_add_lua_file(app lua/navigation.lua)
zephyrbt_add_lua_file(app lua/safety.lua)
zephyrbt_add_lua_file(app lua/mission.lua)
```

## Kconfig
```
# Copyright (c) 2026 O.S. Systems Software LTDA.
# Copyright (c) 2026 Freedom Veiculos Eletricos
# SPDX-License-Identifier: Apache-2.0

mainmenu "Robot Patrol Sample"

source "Kconfig.zephyr"

config ROBOT_PATROL_TEST_MODE
	bool "Test mode (LOG_INF output instead of terminal UI)"
	help
	  When enabled, display_render outputs LOG_INF lines
	  instead of the ANSI terminal UI, allowing automated
	  testing via console harness regex matching.
```

## sample.yaml
```
# Copyright (c) 2026 O.S. Systems Software LTDA.
# Copyright (c) 2026 Freedom Veiculos Eletricos
# SPDX-License-Identifier: Apache-2.0

sample:
  name: Zephyr Behaviour Tree - Robot Patrol
  description: |
    Advanced sample demonstrating a mobile robot that patrols
    waypoints on an 8x8 grid using BFS pathfinding, manages
    battery, and handles emergencies. Exercises subtrees with
    port aliasing, Lua pre/post conditions, and 4 user Lua
    override files. Features a live terminal UI animation.
common:
  tags:
    - zephyrbt
    - lua
tests:
  samples.zephyrbt.robot_patrol:
    platform_allow:
      - native_sim/native/64
      - mps2/an385
    extra_configs:
      - CONFIG_ROBOT_PATROL_TEST_MODE=y
      - CONFIG_LOG_DEFAULT_LEVEL=3
      - CONFIG_ZEPHYR_BEHAVIOUR_TREE_LOG_LEVEL_INF=y
    timeout: 30
    harness: console
    harness_config:
      type: multi_line
      ordered: true
      regex:
        # 1. Start at home with full battery
        - "pos=\\(0,7\\) bat=100.*status=idle"
        # 2. Navigate to W1
        - "scan=0/4.*status=Navigating"
        # 3. Arrive + scan W1
        - "pos=\\(0,3\\).*status=Arrived at waypoint"
        - "status=Searching"
        - "scan=1/4.*status=Found"
        # 4. Return home, head to W2
        - "scan=1/4.*status=Heading home"
        - "scan=1/4.*status=Navigating"
        # 5. Scan W2
        - "scan=2/4.*status=Found"
        # 6. Scan W3
        - "scan=3/4.*status=Found"
        # 7. Scan W4 — all waypoints done
        - "scan=4/4.*status=Found"
        # 8. Battery emergency during return
        - "status=Emergency: moving"
        # 9. Charging at charger
        - "pos=\\(0,0\\).*status=Charging"
        - "bat=100.*status=Charging"
        # 10. Resume patrol after charge
        - "status=Resuming patrol"
        # 11. Navigate home for celebration
        - "pos=\\(0,7\\).*status=Mission 1 complete"
        # 12. New mission starts
        - "scan=0/4.*status=Navigating"
```

## prj.conf
```kconfig
# Copyright (c) 2026 O.S. Systems Software LTDA.
# Copyright (c) 2026 Freedom Veiculos Eletricos
# SPDX-License-Identifier: Apache-2.0

CONFIG_LOG=y
CONFIG_LOG_MODE_MINIMAL=y
CONFIG_LOG_DEFAULT_LEVEL=0

CONFIG_ZEPHYR_BEHAVIOUR_TREE=y
CONFIG_ZEPHYR_BEHAVIOUR_TREE_DYNAMIC=y
CONFIG_ZEPHYR_BEHAVIOUR_TREE_NODE_INFO=y
CONFIG_ZEPHYR_BEHAVIOUR_TREE_NODE_INIT=y
CONFIG_ZEPHYR_BEHAVIOUR_TREE_NODE_CONTEXT=y
CONFIG_ZEPHYR_BEHAVIOUR_TREE_USER_DATA=y
CONFIG_ZEPHYR_BEHAVIOUR_TREE_LUA_CONDITIONS=y
CONFIG_ZEPHYR_BEHAVIOUR_TREE_LOG_LEVEL_WRN=y

CONFIG_LUA=y

CONFIG_DYNAMIC_THREAD=y
CONFIG_DYNAMIC_THREAD_ALLOC=y
CONFIG_THREAD_STACK_INFO=y
CONFIG_KERNEL_MEM_POOL=y
CONFIG_HEAP_MEM_POOL_SIZE=65536
```

## include/robot_state.h
```c
/*
 * Copyright (c) 2026 O.S. Systems Software LTDA.
 * Copyright (c) 2026 Freedom Veiculos Eletricos
 *
 * SPDX-License-Identifier: Apache-2.0
 */

#ifndef ROBOT_STATE_H_
#define ROBOT_STATE_H_

#include <stdint.h>
#include <stdbool.h>

struct zephyrbt_blackboard_item;

#define GRID_SIZE     8
#define MAX_PATH      64
#define NUM_WAYPOINTS 4
#define BATTERY_START 100
#define BATTERY_MOVE  1
#define BATTERY_SCAN  5
#define SCAN_RADIUS   1 /* 3x3 area */

/* Grid cell values */
#define CELL_FREE     0
#define CELL_OBSTACLE 1
#define CELL_TARGET   2

/* Navigation status */
#define NAV_IDLE      0
#define NAV_COMPUTING 1
#define NAV_FOLLOWING 2
#define NAV_ARRIVED   3

/* Fixed positions */
#define CHARGER_X 0
#define CHARGER_Y 0
#define HOME_X    0
#define HOME_Y    7
#define SAFE_X    4
#define SAFE_Y    4
#define START_X   0
#define START_Y   7

/* Thresholds */
#define CRITICAL_BATTERY 20
#define MIN_CLEARANCE    1

struct robot_path {
	int8_t steps[MAX_PATH][2];
	int8_t len;
	int8_t idx;
	bool valid;
};

struct robot_state {
	uint8_t grid[GRID_SIZE][GRID_SIZE];
	int8_t waypoints[NUM_WAYPOINTS][2];
	struct robot_path path;
	int16_t total_targets;
	struct zephyrbt_blackboard_item *battery_item;
	struct zephyrbt_blackboard_item *pos_x_item;
	struct zephyrbt_blackboard_item *pos_y_item;
	struct zephyrbt_blackboard_item *charging_item;
	int16_t mission_num;
	int8_t charging;
	bool initialized;
};

/* BFS pathfinding on the grid. Returns path length or -1. */
int robot_bfs(struct robot_state *state, int from_x, int from_y, int to_x, int to_y);

/* Get the global robot state. */
struct robot_state *robot_get_state(void);

/* Randomize targets for a new mission. */
void robot_new_mission(struct robot_state *state);

/* Terminal UI display functions */
void display_init(void);
void display_tick(void);
int display_get_tick(void);
void display_render(struct robot_state *state, int pos_x, int pos_y, int battery, int tick);
void display_update_nav(int wp_idx, int tx, int ty, int step, int total);
void display_update_scan(int targets_total, int found);
void display_set_scanning(int phase);
void display_update_status(const char *msg);
void display_set_visited(int wp_idx);

#endif /* ROBOT_STATE_H_ */
```

## include/zephyrbt_user.h
```c
/*
 * Copyright (c) 2026 O.S. Systems Software LTDA.
 * Copyright (c) 2026 Freedom Veiculos Eletricos
 *
 * SPDX-License-Identifier: Apache-2.0
 */

#ifndef ZEPHYRBT_USER_H_
#define ZEPHYRBT_USER_H_

#endif /* ZEPHYRBT_USER_H_ */
```

## src/charge.c
```c
/*
 * Copyright (c) 2026 O.S. Systems Software LTDA.
 * Copyright (c) 2026 Freedom Veiculos Eletricos
 *
 * SPDX-License-Identifier: Apache-2.0
 */

#include <stdint.h>
#include <zephyr/zephyrbt/zephyrbt.h>
#include <zephyr/logging/log.h>

LOG_MODULE_REGISTER(charge, CONFIG_ZEPHYR_BEHAVIOUR_TREE_LOG_LEVEL);

#include "robot_patrol.h"
#include "robot_state.h"

/*
 * Charge node: recharge the battery when parked at the charger.
 *
 * Returns RUNNING while battery < BATTERY_START, SUCCESS once
 * full.  Callers typically gate it with
 *   _skipIf="bb.pos_x ~= bb.charger_x or
 *            bb.pos_y ~= bb.charger_y"
 * so obstacle emergencies (response != charger) no-op through.
 */

#define CHARGE_TICKS_PER_UNIT 2
#define CHARGE_UNIT           5

struct charge_ctx {
	struct zephyrbt_blackboard_item *battery;
	struct zephyrbt_blackboard_item *charging;
	int16_t charge_ticks;
};

enum zephyrbt_child_status zephyrbt_action_charge_init(struct zephyrbt_context *ctx,
						       struct zephyrbt_node *self)
{
	struct charge_ctx *c = k_malloc(sizeof(*c));

	if (c == NULL) {
		return ZEPHYRBT_CHILD_FAILURE_STATUS;
	}

	c->battery =
		zephyrbt_search_blackboard(ctx, self->index, ZEPHYRBT_CHARGE_ATTRIBUTE_BATTERY);
	c->charging =
		zephyrbt_search_blackboard(ctx, self->index, ZEPHYRBT_CHARGE_ATTRIBUTE_CHARGING);

	c->charge_ticks = 0;

	self->ctx = c;
	return ZEPHYRBT_CHILD_SUCCESS_STATUS;
}

enum zephyrbt_child_status zephyrbt_action_charge(struct zephyrbt_context *ctx,
						  struct zephyrbt_node *self)
{
	struct charge_ctx *c = (struct charge_ctx *)self->ctx;
	struct robot_state *rs = robot_get_state();

	intptr_t bat = (intptr_t)c->battery->item;

	if (bat >= BATTERY_START) {
		/* Fully charged — exit emergency loop */
		rs->charging = 0;
		c->charging->item = (zephyrbt_node_context_t)0;
		c->charge_ticks = 0;
		display_update_status("Resuming patrol...");
		return ZEPHYRBT_CHILD_SUCCESS_STATUS;
	}

	rs->charging = 1;
	c->charging->item = (zephyrbt_node_context_t)1;
	c->charge_ticks++;

	if (c->charge_ticks % CHARGE_TICKS_PER_UNIT == 0) {
		bat += CHARGE_UNIT;
		if (bat > BATTERY_START) {
			bat = BATTERY_START;
		}
		c->battery->item = (zephyrbt_node_context_t)bat;
	}

	display_update_status("Charging...");
	return ZEPHYRBT_CHILD_RUNNING_STATUS;
}
```

## src/display.c
```c
/*
 * Copyright (c) 2026 O.S. Systems Software LTDA.
 * Copyright (c) 2026 Freedom Veiculos Eletricos
 *
 * SPDX-License-Identifier: Apache-2.0
 */

#include <stdio.h>
#include <zephyr/logging/log.h>
#include "robot_state.h"

LOG_MODULE_REGISTER(robot_patrol, LOG_LEVEL_INF);

/* ANSI escape codes */
#define CSI        "\x1b["
#define CUR_HOME   CSI "H"
#define CLR_SCREEN CSI "2J"
#define CLR_LINE   CSI "K"
#define BOLD       CSI "1m"
#define DIM        CSI "2m"
#define RST        CSI "0m"
#define RED        CSI "31m"
#define GRN        CSI "32m"
#define YEL        CSI "33m"
#define CYN        CSI "36m"
#define MAG        CSI "35m"

/* Display state — updated by node tick functions */
static struct display_state {
	int target_wp;
	int target_x;
	int target_y;
	int step;
	int step_total;
	int scans_done;
	int targets_found;
	uint8_t visited;
	int last_scan_found;
	int scanning; /* 0=off, 1=arrived, 2=searching, 3=found */
	int last_tick;
	char status[48];
} g_disp;

void display_init(void)
{
	g_disp.target_wp = -1;
	g_disp.status[0] = '\0';
#ifndef CONFIG_ROBOT_PATROL_TEST_MODE
	printf(CLR_SCREEN);
	fflush(stdout);
#endif
}

void display_update_nav(int wp_idx, int tx, int ty, int step, int total)
{
	if (wp_idx >= 0) {
		g_disp.target_wp = wp_idx;
		g_disp.target_x = tx;
		g_disp.target_y = ty;
	}
	g_disp.step = step;
	g_disp.step_total = total;
}

void display_update_scan(int targets_total, int found)
{
	g_disp.targets_found = targets_total;
	g_disp.last_scan_found = found;
}

void display_tick(void)
{
	g_disp.last_tick++;
}

int display_get_tick(void)
{
	return g_disp.last_tick;
}

void display_set_scanning(int phase)
{
	g_disp.scanning = phase;
}

void display_update_status(const char *msg)
{
	int i;

	for (i = 0; i < 47 && msg[i]; i++) {
		g_disp.status[i] = msg[i];
	}
	g_disp.status[i] = '\0';
}

void display_set_visited(int wp_idx)
{
	if (wp_idx == -2) {
		/* Reset all */
		g_disp.visited = 0;
		g_disp.scans_done = 0;
		g_disp.targets_found = 0;
		g_disp.target_wp = -1;
		return;
	}
	if (wp_idx < 0) {
		wp_idx = g_disp.target_wp;
	}
	if (wp_idx >= 0 && wp_idx < NUM_WAYPOINTS) {
		if (!(g_disp.visited & (1 << wp_idx))) {
			g_disp.visited |= (1 << wp_idx);
			g_disp.scans_done++;
		}
	}
}

static int is_waypoint(struct robot_state *s, int x, int y, int *wp_idx)
{
	for (int i = 0; i < NUM_WAYPOINTS; i++) {
		if (s->waypoints[i][0] == x && s->waypoints[i][1] == y) {
			*wp_idx = i;
			return 1;
		}
	}
	return 0;
}

static void print_cell(struct robot_state *s, int x, int y, int rx, int ry)
{
	int wp;

	if (x == rx && y == ry) {
		if (g_disp.scanning == 1) {
			printf(BOLD MAG "? " RST);
		} else if (g_disp.scanning == 2) {
			printf(BOLD GRN "! " RST);
		} else {
			printf(BOLD GRN "R " RST);
		}
	} else if (x == CHARGER_X && y == CHARGER_Y) {
		printf(YEL "C " RST);
	} else if (x == HOME_X && y == HOME_Y) {
		printf(CYN "H " RST);
	} else if (is_waypoint(s, x, y, &wp)) {
		if (g_disp.visited & (1 << wp)) {
			printf(CYN "v " RST);
		} else {
			printf(YEL "W " RST);
		}
	} else if (s->grid[y][x] == CELL_OBSTACLE) {
		printf(RED "# " RST);
	} else if (s->grid[y][x] == CELL_TARGET) {
		printf(MAG "* " RST);
	} else {
		printf(DIM ". " RST);
	}
}

static void print_battery(char *buf, int sz, int battery)
{
	int fill = battery / 10;
	int pos = 0;

	pos += snprintf(buf + pos, sz - pos, "Bat [");
	for (int i = 0; i < 10 && pos < sz - 1; i++) {
		buf[pos++] = i < fill ? '=' : ' ';
	}
	pos += snprintf(buf + pos, sz - pos, "]%4d", battery);
	buf[pos] = '\0';
}

static const char *bat_color(int battery)
{
	if (battery > 50) {
		return GRN;
	} else if (battery > 20) {
		return YEL;
	}
	return RED;
}

/*
 * Right panel: fixed 26 visible chars so the border
 * aligns. ANSI codes don't count as visible chars.
 * Format: "  %-26s" but we build manually since
 * ANSI codes mess up printf width counting.
 */
static char rbuf[128];

static void print_right(int row, int battery, int pos_x, int pos_y, int tick)
{
	int n = 0;

	rbuf[0] = '\0';
	switch (row) {
	case 0:
		/* Battery rendered separately */
		break;
	case 1:
		n = snprintf(rbuf, sizeof(rbuf), "Pos     (%d,%d)", pos_x, pos_y);
		break;
	case 2:
		if (g_disp.target_wp >= 0) {
			n = snprintf(rbuf, sizeof(rbuf), "Target  W%d (%d,%d)",
				     g_disp.target_wp + 1, g_disp.target_x, g_disp.target_y);
		} else {
			n = snprintf(rbuf, sizeof(rbuf), "Target  --");
		}
		break;
	case 3:
		if (g_disp.step_total > 0) {
			n = snprintf(rbuf, sizeof(rbuf), "Step    %d/%d", g_disp.step,
				     g_disp.step_total);
		} else {
			n = snprintf(rbuf, sizeof(rbuf), "Step    --");
		}
		break;
	case 4:
		n = snprintf(rbuf, sizeof(rbuf), "Scanned %d/%d", g_disp.scans_done, NUM_WAYPOINTS);
		break;
	case 5:
		n = snprintf(rbuf, sizeof(rbuf), "Targets %d", g_disp.targets_found);
		break;
	case 6:
		n = snprintf(rbuf, sizeof(rbuf), "Tick    %d", tick);
		break;
	case 7:
		n = snprintf(rbuf, sizeof(rbuf), "%s", g_disp.status);
		break;
	default:
		break;
	}

	if (row == 0) {
		print_battery(rbuf, sizeof(rbuf), battery);
	}
	if (row == 0) {
		printf(" %s%s" RST, bat_color(battery), rbuf);
	} else {
		printf(" %s", rbuf);
	}
	printf(CLR_LINE CSI "47G|");
}

void display_render(struct robot_state *state, int pos_x, int pos_y, int battery, int tick)
{
	/* Tick always increases — take the max */
	if (tick > g_disp.last_tick) {
		g_disp.last_tick = tick;
	} else {
		tick = g_disp.last_tick;
	}

	/* Override status for celebration */
	if (g_disp.scans_done >= NUM_WAYPOINTS && pos_x == HOME_X && pos_y == HOME_Y &&
	    battery >= CRITICAL_BATTERY) {
		snprintf(g_disp.status, sizeof(g_disp.status), "Mission %d complete!",
			 state->mission_num);
	}

#ifdef CONFIG_ROBOT_PATROL_TEST_MODE
	LOG_INF("tick=%d pos=(%d,%d) bat=%d scan=%d/%d "
		"targets=%d status=%s",
		tick, pos_x, pos_y, battery, g_disp.scans_done, NUM_WAYPOINTS, g_disp.targets_found,
		g_disp.status[0] ? g_disp.status : "idle");
	return;
#endif
	if (g_disp.scans_done >= NUM_WAYPOINTS && pos_x == HOME_X && pos_y == HOME_Y &&
	    battery >= CRITICAL_BATTERY) {
		snprintf(g_disp.status, sizeof(g_disp.status), "Mission %d complete!",
			 state->mission_num);
	}

	printf(CUR_HOME);

	/* Title */
	printf("+---------------------------------------------+\n");
	printf("| " BOLD "ZephyrBT Robot Patrol" RST CSI "47G|\n");
	printf("+---------------------------------------------+\n");

	/* Column headers + battery */
	printf("|  " DIM " 0 1 2 3 4 5 6 7" RST);
	print_right(0, battery, pos_x, pos_y, tick);
	printf("\n");

	/* Grid rows + right panel */
	for (int y = 0; y < GRID_SIZE; y++) {
		printf("| " DIM "%d" RST " ", y);
		for (int x = 0; x < GRID_SIZE; x++) {
			print_cell(state, x, y, pos_x, pos_y);
		}
		print_right(y + 1, battery, pos_x, pos_y, tick);
		printf("\n");
	}

	/*
	 * Legend rows. Use CSI K (clear to EOL) then
	 * move cursor to column 47 for the right |.
	 */
	printf("| " BOLD GRN "R" RST "=Robot " YEL "C" RST "=Charger " CYN "H" RST "=Home " YEL
	       "W" RST "=Waypoint" CSI "47G|\n");
	printf("| " CYN "v" RST "=Visited " RED "#" RST "=Obstacle " MAG "*" RST "=Target" CSI
	       "47G|\n");

	printf("+---------------------------------------------+\n");

	fflush(stdout);
}
```

## src/emergency.c
```c
/*
 * Copyright (c) 2026 O.S. Systems Software LTDA.
 * Copyright (c) 2026 Freedom Veiculos Eletricos
 *
 * SPDX-License-Identifier: Apache-2.0
 */

#include <stdint.h>
#include <zephyr/zephyrbt/zephyrbt.h>
#include <zephyr/logging/log.h>

LOG_MODULE_REGISTER(emergency, CONFIG_ZEPHYR_BEHAVIOUR_TREE_LOG_LEVEL);

#include "robot_patrol.h"
#include "robot_state.h"

/*
 * CheckMetric: compare metric against threshold.  Returns SUCCESS
 * (emergency!) when the metric drops below the threshold or while
 * charging is already in progress (so the HandleEmergency subtree
 * completes its charge cycle before yielding to patrol).
 *
 * On SUCCESS, announces "Emergency: moving" so the follow-up
 * NavigateTo instance paints the correct status while it steps.
 */

struct check_metric_ctx {
	struct zephyrbt_blackboard_item *metric;
	struct zephyrbt_blackboard_item *threshold;
	struct zephyrbt_blackboard_item *charging;
};

enum zephyrbt_child_status zephyrbt_action_check_metric_init(struct zephyrbt_context *ctx,
							     struct zephyrbt_node *self)
{
	struct check_metric_ctx *c = k_malloc(sizeof(*c));

	if (c == NULL) {
		return ZEPHYRBT_CHILD_FAILURE_STATUS;
	}

	c->metric = zephyrbt_search_blackboard(ctx, self->index,
					       ZEPHYRBT_CHECK_METRIC_ATTRIBUTE_METRIC);
	c->threshold = zephyrbt_search_blackboard(ctx, self->index,
						  ZEPHYRBT_CHECK_METRIC_ATTRIBUTE_THRESHOLD);
	c->charging = zephyrbt_search_blackboard(ctx, self->index,
						 ZEPHYRBT_CHECK_METRIC_ATTRIBUTE_CHARGING);

	self->ctx = c;
	return ZEPHYRBT_CHILD_SUCCESS_STATUS;
}

enum zephyrbt_child_status zephyrbt_action_check_metric(struct zephyrbt_context *ctx,
							struct zephyrbt_node *self)
{
	struct check_metric_ctx *c = (struct check_metric_ctx *)self->ctx;

	int metric = (intptr_t)c->metric->item;
	int threshold = (intptr_t)c->threshold->item;
	int charging = (intptr_t)c->charging->item;

	if (metric < threshold || charging > 0) {
		display_update_status("Emergency: moving");
		return ZEPHYRBT_CHILD_SUCCESS_STATUS;
	}

	return ZEPHYRBT_CHILD_FAILURE_STATUS;
}
```

## src/lua_scripts.c
```c
/*
 * Copyright (c) 2026 O.S. Systems Software LTDA.
 * Copyright (c) 2026 Freedom Veiculos Eletricos
 *
 * SPDX-License-Identifier: Apache-2.0
 */

/*
 * Wire user Lua override files into the BT context.
 * Headers are generated by zephyrbt_add_lua_file() via
 * lua_zephyr's luaz_gen.py script.
 *
 * Loading order matters: diagnostics.lua first since
 * other files depend on manhattan().
 */

#include <zephyr/zephyrbt/zephyrbt.h>

#include "diagnostics_lua_script.h"
#include "navigation_lua_script.h"
#include "safety_lua_script.h"
#include "mission_lua_script.h"

static const char *const user_scripts[] = {
	diagnostics_lua_script,
	navigation_lua_script,
	safety_lua_script,
	mission_lua_script,
};

void zephyrbt_lua_user_init(struct zephyrbt_context *ctx)
{
	ctx->lua_user_scripts = user_scripts;
	ctx->lua_user_script_count = 4;
}
```

## src/navigation.c
```c
/*
 * Copyright (c) 2026 O.S. Systems Software LTDA.
 * Copyright (c) 2026 Freedom Veiculos Eletricos
 *
 * SPDX-License-Identifier: Apache-2.0
 */

#include <stdint.h>
#include <string.h>
#include <zephyr/zephyrbt/zephyrbt.h>
#include <zephyr/logging/log.h>

LOG_MODULE_REGISTER(navigation, CONFIG_ZEPHYR_BEHAVIOUR_TREE_LOG_LEVEL);

#include "robot_patrol.h"
#include "robot_state.h"

/*
 * Per-instance path storage.
 * ComputePath and FollowPath within the same NavigateTo
 * subtree share a nav_status bb item (port aliased).
 * We use that pointer as a key to look up the shared path.
 */
#define MAX_NAV_INSTANCES 4

static struct robot_path g_nav_paths[MAX_NAV_INSTANCES];
static struct zephyrbt_blackboard_item *g_nav_keys[MAX_NAV_INSTANCES];
static int g_nav_count;

static struct robot_path *get_nav_path(struct zephyrbt_blackboard_item *nav_item)
{
	for (int i = 0; i < g_nav_count; i++) {
		if (g_nav_keys[i] == nav_item) {
			return &g_nav_paths[i];
		}
	}

	if (g_nav_count >= MAX_NAV_INSTANCES) {
		return &g_nav_paths[0];
	}

	g_nav_keys[g_nav_count] = nav_item;
	return &g_nav_paths[g_nav_count++];
}

/*
 * BFS pathfinding on the 8x8 grid.
 * Finds shortest path from (from_x,from_y) to (to_x,to_y).
 * Stores result in the provided path struct.
 * Returns path length or -1.
 */
int robot_bfs(struct robot_state *state, int from_x, int from_y, int to_x, int to_y)
{
	struct robot_path *p = &state->path;
	int8_t visited[GRID_SIZE][GRID_SIZE];
	int8_t parent_x[GRID_SIZE][GRID_SIZE];
	int8_t parent_y[GRID_SIZE][GRID_SIZE];
	int8_t queue_x[GRID_SIZE * GRID_SIZE];
	int8_t queue_y[GRID_SIZE * GRID_SIZE];
	int head = 0;
	int tail = 0;

	/* 4-connected neighbors: right, down, left, up */
	static const int8_t dx[] = {1, 0, -1, 0};
	static const int8_t dy[] = {0, 1, 0, -1};

	memset(visited, 0, sizeof(visited));
	memset(parent_x, -1, sizeof(parent_x));
	memset(parent_y, -1, sizeof(parent_y));

	if (from_x == to_x && from_y == to_y) {
		p->len = 0;
		p->idx = 0;
		p->valid = true;
		return 0;
	}

	queue_x[tail] = from_x;
	queue_y[tail] = from_y;
	tail++;
	visited[from_y][from_x] = 1;

	while (head < tail) {
		int cx = queue_x[head];
		int cy = queue_y[head];

		head++;

		for (int d = 0; d < 4; d++) {
			int nx = cx + dx[d];
			int ny = cy + dy[d];

			if (nx < 0 || nx >= GRID_SIZE || ny < 0 || ny >= GRID_SIZE) {
				continue;
			}

			if (visited[ny][nx]) {
				continue;
			}

			if (state->grid[ny][nx] == CELL_OBSTACLE) {
				continue;
			}

			visited[ny][nx] = 1;
			parent_x[ny][nx] = cx;
			parent_y[ny][nx] = cy;

			if (nx == to_x && ny == to_y) {
				goto found;
			}

			queue_x[tail] = nx;
			queue_y[tail] = ny;
			tail++;
		}
	}

	p->valid = false;
	return -1;

found:
	p->len = 0;
	{
		int cx = to_x;
		int cy = to_y;

		while (cx != from_x || cy != from_y) {
			if (p->len >= MAX_PATH) {
				p->valid = false;
				return -1;
			}
			p->steps[p->len][0] = cx;
			p->steps[p->len][1] = cy;
			p->len++;

			int px = parent_x[cy][cx];
			int py = parent_y[cy][cx];

			cx = px;
			cy = py;
		}
	}

	/* Reverse the path (it was built backward) */
	for (int i = 0; i < p->len / 2; i++) {
		int j = p->len - 1 - i;
		int8_t tx = p->steps[i][0];
		int8_t ty = p->steps[i][1];

		p->steps[i][0] = p->steps[j][0];
		p->steps[i][1] = p->steps[j][1];
		p->steps[j][0] = tx;
		p->steps[j][1] = ty;
	}

	p->idx = 0;
	p->valid = true;
	return p->len;
}

/* ---- ComputePath node ---- */

struct compute_path_ctx {
	struct zephyrbt_blackboard_item *target_x;
	struct zephyrbt_blackboard_item *target_y;
	struct zephyrbt_blackboard_item *pos_x;
	struct zephyrbt_blackboard_item *pos_y;
	struct zephyrbt_blackboard_item *nav_status;
};

enum zephyrbt_child_status zephyrbt_action_compute_path_init(struct zephyrbt_context *ctx,
							     struct zephyrbt_node *self)
{
	struct compute_path_ctx *c = k_malloc(sizeof(*c));

	if (c == NULL) {
		return ZEPHYRBT_CHILD_FAILURE_STATUS;
	}

	c->target_x = zephyrbt_search_blackboard(ctx, self->index,
						 ZEPHYRBT_COMPUTE_PATH_ATTRIBUTE_TARGET_X);
	c->target_y = zephyrbt_search_blackboard(ctx, self->index,
						 ZEPHYRBT_COMPUTE_PATH_ATTRIBUTE_TARGET_Y);
	c->pos_x =
		zephyrbt_search_blackboard(ctx, self->index, ZEPHYRBT_COMPUTE_PATH_ATTRIBUTE_POS_X);
	c->pos_y =
		zephyrbt_search_blackboard(ctx, self->index, ZEPHYRBT_COMPUTE_PATH_ATTRIBUTE_POS_Y);
	c->nav_status = zephyrbt_search_blackboard(ctx, self->index,
						   ZEPHYRBT_COMPUTE_PATH_ATTRIBUTE_NAV_STATUS);

	self->ctx = c;
	return ZEPHYRBT_CHILD_SUCCESS_STATUS;
}

enum zephyrbt_child_status zephyrbt_action_compute_path(struct zephyrbt_context *ctx,
							struct zephyrbt_node *self)
{
	struct compute_path_ctx *c = (struct compute_path_ctx *)self->ctx;
	struct robot_state *s = robot_get_state();

	int fx = (intptr_t)c->pos_x->item;
	int fy = (intptr_t)c->pos_y->item;
	int tx = (intptr_t)c->target_x->item;
	int ty = (intptr_t)c->target_y->item;
	int len = robot_bfs(s, fx, fy, tx, ty);

	if (len < 0) {
		LOG_ERR("compute_path: no path "
			"(%d,%d)->(%d,%d)",
			fx, fy, tx, ty);
		c->nav_status->item = (zephyrbt_node_context_t)(intptr_t)NAV_IDLE;
		return ZEPHYRBT_CHILD_FAILURE_STATUS;
	}

	/* Copy BFS result to per-instance path */
	struct robot_path *np = get_nav_path(c->nav_status);
	memcpy(np, &s->path, sizeof(*np));

	c->nav_status->item = (zephyrbt_node_context_t)(intptr_t)NAV_FOLLOWING;

	/* Clear any scan animation left over from a scan
	 * aborted by _failureIf (e.g. battery drained below
	 * threshold mid-scan) so the robot renders as R
	 * while moving, not ? or !. */
	display_set_scanning(0);
	display_update_status("Computing path...");

	return ZEPHYRBT_CHILD_SUCCESS_STATUS;
}

/* ---- FollowPath node ---- */

struct follow_path_ctx {
	struct zephyrbt_blackboard_item *pos_x;
	struct zephyrbt_blackboard_item *pos_y;
	struct zephyrbt_blackboard_item *battery;
	struct zephyrbt_blackboard_item *nav_status;
};

enum zephyrbt_child_status zephyrbt_action_follow_path_init(struct zephyrbt_context *ctx,
							    struct zephyrbt_node *self)
{
	struct follow_path_ctx *c = k_malloc(sizeof(*c));

	if (c == NULL) {
		return ZEPHYRBT_CHILD_FAILURE_STATUS;
	}

	c->pos_x =
		zephyrbt_search_blackboard(ctx, self->index, ZEPHYRBT_FOLLOW_PATH_ATTRIBUTE_POS_X);
	c->pos_y =
		zephyrbt_search_blackboard(ctx, self->index, ZEPHYRBT_FOLLOW_PATH_ATTRIBUTE_POS_Y);
	c->battery = zephyrbt_search_blackboard(ctx, self->index,
						ZEPHYRBT_FOLLOW_PATH_ATTRIBUTE_BATTERY);
	c->nav_status = zephyrbt_search_blackboard(ctx, self->index,
						   ZEPHYRBT_FOLLOW_PATH_ATTRIBUTE_NAV_STATUS);

	self->ctx = c;
	return ZEPHYRBT_CHILD_SUCCESS_STATUS;
}

enum zephyrbt_child_status zephyrbt_action_follow_path(struct zephyrbt_context *ctx,
						       struct zephyrbt_node *self)
{
	struct follow_path_ctx *c = (struct follow_path_ctx *)self->ctx;

	struct robot_path *p = get_nav_path(c->nav_status);

	if (!p->valid || p->idx >= p->len) {
		int px = (intptr_t)c->pos_x->item;
		int py = (intptr_t)c->pos_y->item;

		c->nav_status->item = (zephyrbt_node_context_t)(intptr_t)NAV_ARRIVED;
		display_update_nav(-1, 0, 0, 0, 0);
		if (px == HOME_X && py == HOME_Y) {
			display_update_status("Arrived home");
		}
		return ZEPHYRBT_CHILD_SUCCESS_STATUS;
	}

	int new_x = p->steps[p->idx][0];
	int new_y = p->steps[p->idx][1];

	p->idx++;

	c->pos_x->item = (zephyrbt_node_context_t)(intptr_t)new_x;
	c->pos_y->item = (zephyrbt_node_context_t)(intptr_t)new_y;

	/* Drain battery per step */
	intptr_t bat = (intptr_t)c->battery->item;

	bat -= BATTERY_MOVE;
	if (bat < 0) {
		bat = 0;
	}
	c->battery->item = (zephyrbt_node_context_t)bat;

	display_update_nav(-1, 0, 0, p->idx, p->len);
	display_update_status(bat < CRITICAL_BATTERY ? "Emergency: moving" : "Navigating...");

	if (p->idx >= p->len) {
		/* Last step moved — return RUNNING so
		 * UpdateWorld renders R here next tick.
		 * The exhausted-path check at the top
		 * will return SUCCESS on the next tick. */
		p->valid = false;
	}

	return ZEPHYRBT_CHILD_RUNNING_STATUS;
}
```

## src/scan.c
```c
/*
 * Copyright (c) 2026 O.S. Systems Software LTDA.
 * Copyright (c) 2026 Freedom Veiculos Eletricos
 *
 * SPDX-License-Identifier: Apache-2.0
 */

#include <stdint.h>
#include <stdio.h>
#include <zephyr/zephyrbt/zephyrbt.h>
#include <zephyr/logging/log.h>

LOG_MODULE_REGISTER(scan, CONFIG_ZEPHYR_BEHAVIOUR_TREE_LOG_LEVEL);

#include "robot_patrol.h"
#include "robot_state.h"

/*
 * Scan animation phases (1 tick each):
 *  -1 IDLE:    Done, return SUCCESS (reset for next)
 *   0 ARRIVED: Show R + "Arrived at waypoint"
 *   1 SEARCH:  Show ? + "Searching..."
 *   2 FOUND:   Show ! + "Found N targets!" (do scan)
 *   3 HOLD:    Show ! + "Heading home..."
 */
#define SCAN_IDLE    -1
#define SCAN_ARRIVED 0
#define SCAN_SEARCH  1
#define SCAN_FOUND   2
#define SCAN_HOLD    3

struct scan_ctx {
	struct zephyrbt_blackboard_item *pos_x;
	struct zephyrbt_blackboard_item *pos_y;
	struct zephyrbt_blackboard_item *battery;
	struct zephyrbt_blackboard_item *scan_result;
	struct zephyrbt_blackboard_item *targets_found;
	struct zephyrbt_blackboard_item *scans_completed;
	struct zephyrbt_blackboard_item *mission_progress;
	int phase;
	int found;
	int last_px;
	int last_py;
};

enum zephyrbt_child_status zephyrbt_action_perform_scan_init(struct zephyrbt_context *ctx,
							     struct zephyrbt_node *self)
{
	struct scan_ctx *c = k_malloc(sizeof(*c));

	if (c == NULL) {
		return ZEPHYRBT_CHILD_FAILURE_STATUS;
	}

	c->pos_x =
		zephyrbt_search_blackboard(ctx, self->index, ZEPHYRBT_PERFORM_SCAN_ATTRIBUTE_POS_X);
	c->pos_y =
		zephyrbt_search_blackboard(ctx, self->index, ZEPHYRBT_PERFORM_SCAN_ATTRIBUTE_POS_Y);
	c->battery = zephyrbt_search_blackboard(ctx, self->index,
						ZEPHYRBT_PERFORM_SCAN_ATTRIBUTE_BATTERY);
	c->scan_result = zephyrbt_search_blackboard(ctx, self->index,
						    ZEPHYRBT_PERFORM_SCAN_ATTRIBUTE_SCAN_RESULT);
	c->targets_found = zephyrbt_search_blackboard(
		ctx, self->index, ZEPHYRBT_PERFORM_SCAN_ATTRIBUTE_TARGETS_FOUND);
	c->scans_completed = zephyrbt_search_blackboard(
		ctx, self->index, ZEPHYRBT_PERFORM_SCAN_ATTRIBUTE_SCANS_COMPLETED);
	c->mission_progress = zephyrbt_search_blackboard(
		ctx, self->index, ZEPHYRBT_PERFORM_SCAN_ATTRIBUTE_MISSION_PROGRESS);
	c->phase = SCAN_ARRIVED;
	c->found = 0;
	c->last_px = -1;
	c->last_py = -1;

	self->ctx = c;
	return ZEPHYRBT_CHILD_SUCCESS_STATUS;
}

enum zephyrbt_child_status zephyrbt_action_perform_scan(struct zephyrbt_context *ctx,
							struct zephyrbt_node *self)
{
	struct scan_ctx *c = (struct scan_ctx *)self->ctx;
	struct robot_state *s = robot_get_state();
	int px = (intptr_t)c->pos_x->item;
	int py = (intptr_t)c->pos_y->item;
	int bat = (intptr_t)c->battery->item;

	/* Position changed since last tick — a previous scan
	 * was aborted by _failureIf (e.g. battery drain) and
	 * the robot moved away. Restart scan from ARRIVED so
	 * the new waypoint gets a full scan. */
	if (px != c->last_px || py != c->last_py) {
		c->phase = SCAN_ARRIVED;
	}
	c->last_px = px;
	c->last_py = py;

	/* IDLE: scan complete, reset for next visit */
	if (c->phase == SCAN_IDLE) {
		display_set_scanning(0);
		display_update_status("Heading home");
		c->phase = SCAN_ARRIVED;
		return ZEPHYRBT_CHILD_SUCCESS_STATUS;
	}

	switch (c->phase) {
	case SCAN_ARRIVED:
		/* Show R at waypoint for one tick */
		display_set_scanning(0);
		display_update_status("Arrived at waypoint");
		display_render(s, px, py, bat, 0);
		c->phase = SCAN_SEARCH;
		return ZEPHYRBT_CHILD_RUNNING_STATUS;

	case SCAN_SEARCH:
		/* Show ? and do the actual scan */
		display_set_scanning(1);
		display_update_status("Searching...");

		c->found = 0;
		for (int dy = -SCAN_RADIUS; dy <= SCAN_RADIUS; dy++) {
			for (int dx = -SCAN_RADIUS; dx <= SCAN_RADIUS; dx++) {
				int sx = px + dx;
				int sy = py + dy;

				if (sx < 0 || sx >= GRID_SIZE || sy < 0 || sy >= GRID_SIZE) {
					continue;
				}
				if (s->grid[sy][sx] == CELL_TARGET) {
					c->found++;
				}
			}
		}

		display_render(s, px, py, bat, 0);
		c->phase = SCAN_FOUND;
		return ZEPHYRBT_CHILD_RUNNING_STATUS;

	case SCAN_FOUND: {
		/* Show ! and report results */
		char msg[48];

		display_set_scanning(2);
		snprintf(msg, sizeof(msg), "Found %d target%s!", c->found,
			 c->found != 1 ? "s" : "");
		display_update_status(msg);

		/* Drain battery */
		bat -= BATTERY_SCAN;
		if (bat < 0) {
			bat = 0;
		}
		c->battery->item = (zephyrbt_node_context_t)(intptr_t)bat;

		/* Update totals */
		intptr_t total = (intptr_t)c->targets_found->item;
		total += c->found;
		c->targets_found->item = (zephyrbt_node_context_t)total;
		c->scan_result->item = (zephyrbt_node_context_t)(intptr_t)c->found;
		s->total_targets = (int)total;

		display_update_scan(s->total_targets, c->found);
		display_set_visited(-1);
		display_render(s, px, py, bat, 0);

		/* Count the scan as completed as soon as the
		 * real work (battery drain + visited bitmap)
		 * has run. _onSuccess would only fire at
		 * SCAN_IDLE, two ticks later — if _failureIf
		 * aborts the node before then (e.g. battery
		 * just fell below critical), scans_completed
		 * would desync from the visited bitmap and the
		 * mission could never reach scans_completed==4. */
		intptr_t sc = (intptr_t)c->scans_completed->item + 1;
		c->scans_completed->item = (zephyrbt_node_context_t)sc;
		c->mission_progress->item =
			(zephyrbt_node_context_t)(intptr_t)((sc * 100) / NUM_WAYPOINTS);

		c->phase = SCAN_HOLD;
		return ZEPHYRBT_CHILD_RUNNING_STATUS;
	}

	case SCAN_HOLD:
		/* Hold ! for one more tick */
		display_set_scanning(2);
		display_update_status("Heading home...");
		display_render(s, px, py, bat, 0);
		c->phase = SCAN_IDLE;
		return ZEPHYRBT_CHILD_RUNNING_STATUS;
	}

	return ZEPHYRBT_CHILD_SUCCESS_STATUS;
}
```

## src/waypoint.c
```c
/*
 * Copyright (c) 2026 O.S. Systems Software LTDA.
 * Copyright (c) 2026 Freedom Veiculos Eletricos
 *
 * SPDX-License-Identifier: Apache-2.0
 */

#include <stdint.h>
#include <zephyr/zephyrbt/zephyrbt.h>
#include <zephyr/logging/log.h>

LOG_MODULE_REGISTER(waypoint, CONFIG_ZEPHYR_BEHAVIOUR_TREE_LOG_LEVEL);

#include "robot_patrol.h"
#include "robot_state.h"

struct select_wp_ctx {
	struct zephyrbt_blackboard_item *wp_x;
	struct zephyrbt_blackboard_item *wp_y;
	struct zephyrbt_blackboard_item *wp_index;
};

enum zephyrbt_child_status zephyrbt_action_select_waypoint_init(struct zephyrbt_context *ctx,
								struct zephyrbt_node *self)
{
	struct select_wp_ctx *c = k_malloc(sizeof(*c));

	if (c == NULL) {
		return ZEPHYRBT_CHILD_FAILURE_STATUS;
	}

	c->wp_x = zephyrbt_search_blackboard(ctx, self->index,
					     ZEPHYRBT_SELECT_WAYPOINT_ATTRIBUTE_WP_X);
	c->wp_y = zephyrbt_search_blackboard(ctx, self->index,
					     ZEPHYRBT_SELECT_WAYPOINT_ATTRIBUTE_WP_Y);
	c->wp_index = zephyrbt_search_blackboard(ctx, self->index,
						 ZEPHYRBT_SELECT_WAYPOINT_ATTRIBUTE_WP_INDEX);

	/* Initialize: no waypoint selected */
	c->wp_x->item = (zephyrbt_node_context_t)(intptr_t)-1;
	c->wp_y->item = (zephyrbt_node_context_t)(intptr_t)-1;
	c->wp_index->item = (zephyrbt_node_context_t)0;

	self->ctx = c;
	return ZEPHYRBT_CHILD_SUCCESS_STATUS;
}

enum zephyrbt_child_status zephyrbt_action_select_waypoint(struct zephyrbt_context *ctx,
							   struct zephyrbt_node *self)
{
	struct select_wp_ctx *c = (struct select_wp_ctx *)self->ctx;
	struct robot_state *s = robot_get_state();

	int idx = (intptr_t)c->wp_index->item;

	if (idx >= NUM_WAYPOINTS) {
		/* Gated by _skipIf="patrol_done(bb)": reaching
		 * this branch means a Lua condition is stale. */
		return ZEPHYRBT_CHILD_FAILURE_STATUS;
	}

	int wx = s->waypoints[idx][0];
	int wy = s->waypoints[idx][1];

	c->wp_x->item = (zephyrbt_node_context_t)(intptr_t)wx;
	c->wp_y->item = (zephyrbt_node_context_t)(intptr_t)wy;

	c->wp_index->item = (zephyrbt_node_context_t)(intptr_t)(idx + 1);

	display_update_nav(idx, wx, wy, 0, 0);
	display_update_status("Heading to waypoint");

	return ZEPHYRBT_CHILD_SUCCESS_STATUS;
}
```

## src/world.c
```c
/*
 * Copyright (c) 2026 O.S. Systems Software LTDA.
 * Copyright (c) 2026 Freedom Veiculos Eletricos
 *
 * SPDX-License-Identifier: Apache-2.0
 */

#include <stdint.h>
#include <string.h>
#include <stdlib.h>
#include <zephyr/zephyrbt/zephyrbt.h>
#include <zephyr/logging/log.h>

LOG_MODULE_REGISTER(world, CONFIG_ZEPHYR_BEHAVIOUR_TREE_LOG_LEVEL);

#include "robot_patrol.h"
#include "robot_state.h"

static struct robot_state g_state;

struct robot_state *robot_get_state(void)
{
	return &g_state;
}

static void init_grid(struct robot_state *s)
{
	memset(s->grid, CELL_FREE, sizeof(s->grid));

	/* Obstacles */
	s->grid[0][2] = CELL_OBSTACLE;
	s->grid[1][2] = CELL_OBSTACLE;
	s->grid[2][4] = CELL_OBSTACLE;
	s->grid[3][4] = CELL_OBSTACLE;
	s->grid[5][1] = CELL_OBSTACLE;
	s->grid[5][2] = CELL_OBSTACLE;

	/* Scan targets (placed near waypoints) */
	s->grid[3][1] = CELL_TARGET;
	s->grid[0][5] = CELL_TARGET;
	s->grid[5][6] = CELL_TARGET;
	s->grid[7][4] = CELL_TARGET;
}

static void init_waypoints(struct robot_state *s)
{
	/* W1 */ s->waypoints[0][0] = 0;
	s->waypoints[0][1] = 3;
	/* W2 */ s->waypoints[1][0] = 6;
	s->waypoints[1][1] = 0;
	/* W3 */ s->waypoints[2][0] = 7;
	s->waypoints[2][1] = 5;
	/* W4 */ s->waypoints[3][0] = 5;
	s->waypoints[3][1] = 7;
}

static int is_reserved(int x, int y)
{
	return (x == CHARGER_X && y == CHARGER_Y) || (x == HOME_X && y == HOME_Y);
}

void robot_new_mission(struct robot_state *s)
{
	/* Clear grid */
	memset(s->grid, CELL_FREE, sizeof(s->grid));

	/* Place 6 random obstacles */
	int placed = 0;

	while (placed < 6) {
		int x = rand() % GRID_SIZE;
		int y = rand() % GRID_SIZE;

		if (s->grid[y][x] == CELL_FREE && !is_reserved(x, y)) {
			s->grid[y][x] = CELL_OBSTACLE;
			placed++;
		}
	}

	/* Place 4 random waypoints */
	for (int i = 0; i < NUM_WAYPOINTS; i++) {
		while (1) {
			int x = rand() % GRID_SIZE;
			int y = rand() % GRID_SIZE;

			if (s->grid[y][x] == CELL_FREE && !is_reserved(x, y)) {
				s->waypoints[i][0] = x;
				s->waypoints[i][1] = y;
				break;
			}
		}
	}

	/* Place targets near each waypoint so scans
	 * find them. Try adjacent cells first. */
	for (int i = 0; i < NUM_WAYPOINTS; i++) {
		int wx = s->waypoints[i][0];
		int wy = s->waypoints[i][1];
		int tries = 0;

		while (tries < 20) {
			int dx = (rand() % 3) - 1;
			int dy = (rand() % 3) - 1;
			int tx = wx + dx;
			int ty = wy + dy;

			if (tx >= 0 && tx < GRID_SIZE && ty >= 0 && ty < GRID_SIZE &&
			    s->grid[ty][tx] == CELL_FREE && !is_reserved(tx, ty)) {
				s->grid[ty][tx] = CELL_TARGET;
				break;
			}
			tries++;
		}
	}

	s->mission_num++;
	s->total_targets = 0;
	s->path.valid = false;
	display_set_visited(-2);
}

static int compute_obstacle_dist(struct robot_state *s, int px, int py)
{
	int min_dist = GRID_SIZE * 2;

	for (int y = 0; y < GRID_SIZE; y++) {
		for (int x = 0; x < GRID_SIZE; x++) {
			if (s->grid[y][x] != CELL_OBSTACLE) {
				continue;
			}
			int dx = px - x;
			int dy = py - y;

			if (dx < 0) {
				dx = -dx;
			}
			if (dy < 0) {
				dy = -dy;
			}

			int dist = dx + dy;

			if (dist < min_dist) {
				min_dist = dist;
			}
		}
	}

	return min_dist;
}

#ifdef CONFIG_ROBOT_PATROL_TEST_MODE
#define BT_DELAY_MSEC 1
#else
#define BT_DELAY_MSEC 500
#endif

/* ---- Sense node ------------------------------------------------
 * Owns one-time world init (grid, RNG seed, blackboard constants)
 * and per-tick sensing (obstacle distance, tick counter, charging
 * flag mirror).  Does not render or decide respawns.
 * -------------------------------------------------------------- */

struct sense_ctx {
	struct zephyrbt_blackboard_item *battery;
	struct zephyrbt_blackboard_item *pos_x;
	struct zephyrbt_blackboard_item *pos_y;
	struct zephyrbt_blackboard_item *obstacle_dist;
	struct zephyrbt_blackboard_item *tick_count;
	struct zephyrbt_blackboard_item *delay_msec;
	struct zephyrbt_blackboard_item *charger_x;
	struct zephyrbt_blackboard_item *charger_y;
	struct zephyrbt_blackboard_item *critical_battery;
	struct zephyrbt_blackboard_item *min_clearance;
	struct zephyrbt_blackboard_item *safe_x;
	struct zephyrbt_blackboard_item *safe_y;
	struct zephyrbt_blackboard_item *home_x;
	struct zephyrbt_blackboard_item *home_y;
	struct zephyrbt_blackboard_item *idle_count;
	struct zephyrbt_blackboard_item *charging;
};

enum zephyrbt_child_status zephyrbt_action_sense_init(struct zephyrbt_context *ctx,
						      struct zephyrbt_node *self)
{
	struct robot_state *s = robot_get_state();
	struct sense_ctx *c = k_malloc(sizeof(*c));

	if (c == NULL) {
		return ZEPHYRBT_CHILD_FAILURE_STATUS;
	}

	if (!s->initialized) {
		srand((unsigned)k_uptime_get());
		init_grid(s);
		init_waypoints(s);
		s->path.valid = false;
		s->mission_num = 1;
		s->initialized = true;
	}

	c->battery = zephyrbt_search_blackboard(ctx, self->index, ZEPHYRBT_SENSE_ATTRIBUTE_BATTERY);
	c->pos_x = zephyrbt_search_blackboard(ctx, self->index, ZEPHYRBT_SENSE_ATTRIBUTE_POS_X);
	c->pos_y = zephyrbt_search_blackboard(ctx, self->index, ZEPHYRBT_SENSE_ATTRIBUTE_POS_Y);
	c->obstacle_dist = zephyrbt_search_blackboard(ctx, self->index,
						      ZEPHYRBT_SENSE_ATTRIBUTE_OBSTACLE_DIST);
	c->tick_count =
		zephyrbt_search_blackboard(ctx, self->index, ZEPHYRBT_SENSE_ATTRIBUTE_TICK_COUNT);
	c->delay_msec =
		zephyrbt_search_blackboard(ctx, self->index, ZEPHYRBT_SENSE_ATTRIBUTE_DELAY_MSEC);
	c->charger_x =
		zephyrbt_search_blackboard(ctx, self->index, ZEPHYRBT_SENSE_ATTRIBUTE_CHARGER_X);
	c->charger_y =
		zephyrbt_search_blackboard(ctx, self->index, ZEPHYRBT_SENSE_ATTRIBUTE_CHARGER_Y);
	c->critical_battery = zephyrbt_search_blackboard(ctx, self->index,
							 ZEPHYRBT_SENSE_ATTRIBUTE_CRITICAL_BATTERY);
	c->min_clearance = zephyrbt_search_blackboard(ctx, self->index,
						      ZEPHYRBT_SENSE_ATTRIBUTE_MIN_CLEARANCE);
	c->safe_x = zephyrbt_search_blackboard(ctx, self->index, ZEPHYRBT_SENSE_ATTRIBUTE_SAFE_X);
	c->safe_y = zephyrbt_search_blackboard(ctx, self->index, ZEPHYRBT_SENSE_ATTRIBUTE_SAFE_Y);
	c->home_x = zephyrbt_search_blackboard(ctx, self->index, ZEPHYRBT_SENSE_ATTRIBUTE_HOME_X);
	c->home_y = zephyrbt_search_blackboard(ctx, self->index, ZEPHYRBT_SENSE_ATTRIBUTE_HOME_Y);
	c->idle_count =
		zephyrbt_search_blackboard(ctx, self->index, ZEPHYRBT_SENSE_ATTRIBUTE_IDLE_COUNT);
	c->charging =
		zephyrbt_search_blackboard(ctx, self->index, ZEPHYRBT_SENSE_ATTRIBUTE_CHARGING);

	/* Robot initial pose and battery */
	c->battery->item = (zephyrbt_node_context_t)(intptr_t)BATTERY_START;
	c->pos_x->item = (zephyrbt_node_context_t)(intptr_t)START_X;
	c->pos_y->item = (zephyrbt_node_context_t)(intptr_t)START_Y;
	c->tick_count->item = (zephyrbt_node_context_t)0;
	c->obstacle_dist->item =
		(zephyrbt_node_context_t)(intptr_t)compute_obstacle_dist(s, START_X, START_Y);

	/* Tree-level constants exposed to Lua predicates */
	c->delay_msec->item = (zephyrbt_node_context_t)(intptr_t)BT_DELAY_MSEC;
	c->charger_x->item = (zephyrbt_node_context_t)(intptr_t)CHARGER_X;
	c->charger_y->item = (zephyrbt_node_context_t)(intptr_t)CHARGER_Y;
	c->critical_battery->item = (zephyrbt_node_context_t)(intptr_t)CRITICAL_BATTERY;
	c->min_clearance->item = (zephyrbt_node_context_t)(intptr_t)MIN_CLEARANCE;
	c->safe_x->item = (zephyrbt_node_context_t)(intptr_t)SAFE_X;
	c->safe_y->item = (zephyrbt_node_context_t)(intptr_t)SAFE_Y;
	c->home_x->item = (zephyrbt_node_context_t)(intptr_t)HOME_X;
	c->home_y->item = (zephyrbt_node_context_t)(intptr_t)HOME_Y;
	c->idle_count->item = (zephyrbt_node_context_t)0;

	/* Cache bb pointers consumed by emergency + display */
	s->battery_item = c->battery;
	s->pos_x_item = c->pos_x;
	s->pos_y_item = c->pos_y;
	s->charging_item = c->charging;

	display_init();

	self->ctx = c;
	return ZEPHYRBT_CHILD_SUCCESS_STATUS;
}

enum zephyrbt_child_status zephyrbt_action_sense(struct zephyrbt_context *ctx,
						 struct zephyrbt_node *self)
{
	struct sense_ctx *c = (struct sense_ctx *)self->ctx;
	struct robot_state *s = robot_get_state();

	int tick = display_get_tick() + 1;
	int px = (intptr_t)c->pos_x->item;
	int py = (intptr_t)c->pos_y->item;

	c->tick_count->item = (zephyrbt_node_context_t)(intptr_t)tick;
	c->obstacle_dist->item =
		(zephyrbt_node_context_t)(intptr_t)compute_obstacle_dist(s, px, py);
	c->charging->item = (zephyrbt_node_context_t)(intptr_t)s->charging;

	return ZEPHYRBT_CHILD_SUCCESS_STATUS;
}

/* ---- Respawn node ----------------------------------------------
 * When Lua signals bb.new_mission=1 (set in on_idle_tick), clear
 * the flag and regenerate obstacles/waypoints/targets for the next
 * mission.  Keeps the world-mutation decision visible in the tree.
 * -------------------------------------------------------------- */

struct respawn_ctx {
	struct zephyrbt_blackboard_item *new_mission;
};

enum zephyrbt_child_status zephyrbt_action_respawn_init(struct zephyrbt_context *ctx,
							struct zephyrbt_node *self)
{
	struct respawn_ctx *c = k_malloc(sizeof(*c));

	if (c == NULL) {
		return ZEPHYRBT_CHILD_FAILURE_STATUS;
	}

	c->new_mission = zephyrbt_search_blackboard(ctx, self->index,
						    ZEPHYRBT_RESPAWN_ATTRIBUTE_NEW_MISSION);

	self->ctx = c;
	return ZEPHYRBT_CHILD_SUCCESS_STATUS;
}

enum zephyrbt_child_status zephyrbt_action_respawn(struct zephyrbt_context *ctx,
						   struct zephyrbt_node *self)
{
	struct respawn_ctx *c = (struct respawn_ctx *)self->ctx;

	if ((intptr_t)c->new_mission->item == 1) {
		c->new_mission->item = (zephyrbt_node_context_t)0;
		robot_new_mission(robot_get_state());
	}

	return ZEPHYRBT_CHILD_SUCCESS_STATUS;
}

/* ---- Render node -----------------------------------------------
 * Reads the current pose and battery and refreshes the terminal
 * display.  All other nodes update display state incrementally via
 * display_update_*; Render is the once-per-tick commit point.
 * -------------------------------------------------------------- */

struct render_ctx {
	struct zephyrbt_blackboard_item *pos_x;
	struct zephyrbt_blackboard_item *pos_y;
	struct zephyrbt_blackboard_item *battery;
	struct zephyrbt_blackboard_item *tick_count;
};

enum zephyrbt_child_status zephyrbt_action_render_init(struct zephyrbt_context *ctx,
						       struct zephyrbt_node *self)
{
	struct render_ctx *c = k_malloc(sizeof(*c));

	if (c == NULL) {
		return ZEPHYRBT_CHILD_FAILURE_STATUS;
	}

	c->pos_x = zephyrbt_search_blackboard(ctx, self->index, ZEPHYRBT_RENDER_ATTRIBUTE_POS_X);
	c->pos_y = zephyrbt_search_blackboard(ctx, self->index, ZEPHYRBT_RENDER_ATTRIBUTE_POS_Y);
	c->battery =
		zephyrbt_search_blackboard(ctx, self->index, ZEPHYRBT_RENDER_ATTRIBUTE_BATTERY);
	c->tick_count =
		zephyrbt_search_blackboard(ctx, self->index, ZEPHYRBT_RENDER_ATTRIBUTE_TICK_COUNT);

	self->ctx = c;
	return ZEPHYRBT_CHILD_SUCCESS_STATUS;
}

enum zephyrbt_child_status zephyrbt_action_render(struct zephyrbt_context *ctx,
						  struct zephyrbt_node *self)
{
	struct render_ctx *c = (struct render_ctx *)self->ctx;

	int px = (intptr_t)c->pos_x->item;
	int py = (intptr_t)c->pos_y->item;
	int bat = (intptr_t)c->battery->item;
	int tick = (intptr_t)c->tick_count->item;

	display_render(robot_get_state(), px, py, bat, tick);

	return ZEPHYRBT_CHILD_SUCCESS_STATUS;
}
```
