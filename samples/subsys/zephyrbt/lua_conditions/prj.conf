## CMakeLists.txt
```
# Copyright (c) 2026 O.S. Systems Software LTDA.
# Copyright (c) 2026 Freedom Veiculos Eletricos
# SPDX-License-Identifier: Apache-2.0

cmake_minimum_required(VERSION 3.20.0)

find_package(Zephyr REQUIRED HINTS $ENV{ZEPHYR_BASE})
include(${ZEPHYR_ZEPHYRBT_MODULE_DIR}/cmake/zephyrbt-from-behaviourtreecpp-xml.cmake)

project(zephyrbt_lua_conditions)

zephyr_include_directories(
    ${CMAKE_CURRENT_SOURCE_DIR}/include
)

target_sources(app PRIVATE
    src/main.c
    src/lua_conditions.c
)

if(NOT CONFIG_NATIVE_APPLICATION)
    target_sources(app PRIVATE src/posix_stubs.c)
endif()

zephyrbt_define_from_behaviourtreecpp_xml(app
    models/lua_conditions.xml
    ${CMAKE_BINARY_DIR}/include
    ${CMAKE_BINARY_DIR}/src
    4096
    0
    yes
)
```

## sample.yaml
```
# Copyright (c) 2026 O.S. Systems Software LTDA.
# Copyright (c) 2026 Freedom Veiculos Eletricos
# SPDX-License-Identifier: Apache-2.0

sample:
  name: Zephyr Behaviour Tree - Lua Conditions
  description: |
    Demonstrates pre/post conditions using Lua scripts on
    behaviour tree nodes. Exercises _skipIf, _successIf,
    _failureIf, _onSuccess, _onFailure, and _post conditions.
common:
  tags:
    - zephyrbt
    - lua
tests:
  samples.zephyrbt.lua_conditions:
    platform_allow:
      - native_sim/native/64
      - mps2/an385
      - nucleo_f767zi
    harness: pytest
    harness_config:
      pytest_root:
        - "pytest"
```

## prj.conf
```kconfig
# Copyright (c) 2026 O.S. Systems Software LTDA.
# Copyright (c) 2026 Freedom Veiculos Eletricos
# SPDX-License-Identifier: Apache-2.0

CONFIG_LOG=y
CONFIG_LOG_MODE_MINIMAL=y

CONFIG_ZEPHYR_BEHAVIOUR_TREE=y
CONFIG_ZEPHYR_BEHAVIOUR_TREE_DYNAMIC=y
CONFIG_ZEPHYR_BEHAVIOUR_TREE_NODE_INFO=y
CONFIG_ZEPHYR_BEHAVIOUR_TREE_NODE_INIT=y
CONFIG_ZEPHYR_BEHAVIOUR_TREE_NODE_CONTEXT=y
CONFIG_ZEPHYR_BEHAVIOUR_TREE_LUA_CONDITIONS=y
CONFIG_ZEPHYR_BEHAVIOUR_TREE_LOG_LEVEL_INF=y

CONFIG_LUA=y

CONFIG_DYNAMIC_THREAD=y
CONFIG_DYNAMIC_THREAD_ALLOC=y
CONFIG_THREAD_STACK_INFO=y
CONFIG_KERNEL_MEM_POOL=y
CONFIG_HEAP_MEM_POOL_SIZE=65536
```

## src/lua_conditions.c
```c
/*
 * Copyright (c) 2026 O.S. Systems Software LTDA.
 * Copyright (c) 2026 Freedom Veiculos Eletricos
 *
 * SPDX-License-Identifier: Apache-2.0
 */

#include <stdint.h>
#include <zephyr/zephyrbt/zephyrbt.h>

#include <zephyr/logging/log.h>
LOG_MODULE_REGISTER(lua_conditions, CONFIG_ZEPHYR_BEHAVIOUR_TREE_LOG_LEVEL);

#include "lua_conditions.h"

enum zephyrbt_child_status zephyrbt_action_increment_init(struct zephyrbt_context *ctx,
							  struct zephyrbt_node *self)
{
	struct zephyrbt_blackboard_item *item =
		zephyrbt_search_blackboard(ctx, self->index, ZEPHYRBT_INCREMENT_ATTRIBUTE_COUNTER);

	self->ctx = item;
	return ZEPHYRBT_CHILD_SUCCESS_STATUS;
}

enum zephyrbt_child_status zephyrbt_action_increment(struct zephyrbt_context *ctx,
						     struct zephyrbt_node *self)
{
	struct zephyrbt_blackboard_item *item = (struct zephyrbt_blackboard_item *)self->ctx;
	intptr_t val = (intptr_t)item->item;

	val++;
	item->item = (zephyrbt_node_context_t)val;
	LOG_INF("increment: counter=%d", (int)val);
	return ZEPHYRBT_CHILD_SUCCESS_STATUS;
}

enum zephyrbt_child_status zephyrbt_condition_check_value_init(struct zephyrbt_context *ctx,
							       struct zephyrbt_node *self)
{
	LOG_DBG("check_value_init");
	return ZEPHYRBT_CHILD_SUCCESS_STATUS;
}

enum zephyrbt_child_status zephyrbt_condition_check_value(struct zephyrbt_context *ctx,
							  struct zephyrbt_node *self)
{
	LOG_INF("check_value: ticked (odd counter)");
	return ZEPHYRBT_CHILD_SUCCESS_STATUS;
}

enum zephyrbt_child_status zephyrbt_action_guarded_action_init(struct zephyrbt_context *ctx,
							       struct zephyrbt_node *self)
{
	LOG_DBG("guarded_action_init");
	return ZEPHYRBT_CHILD_SUCCESS_STATUS;
}

enum zephyrbt_child_status zephyrbt_action_guarded_action(struct zephyrbt_context *ctx,
							  struct zephyrbt_node *self)
{
	LOG_INF("guarded_action: executed");
	return ZEPHYRBT_CHILD_SUCCESS_STATUS;
}
```

## src/posix_stubs.c
```c
/*
 * Copyright (c) 2026 O.S. Systems Software LTDA.
 * Copyright (c) 2026 Freedom Veiculos Eletricos
 *
 * SPDX-License-Identifier: Apache-2.0
 */

/*
 * Minimal stubs for POSIX functions referenced by Lua's
 * io/os libraries (liolib.c, loslib.c). These libraries
 * are compiled by lua_zephyr but never used by ZephyrBT
 * condition scripts. The stubs satisfy the linker.
 */

#include <errno.h>
#include <sys/types.h>

int open(const char *path, int flags, ...)
{
	errno = ENOSYS;
	return -1;
}

int close(int fd)
{
	errno = ENOSYS;
	return -1;
}

ssize_t read(int fd, void *buf, size_t count)
{
	errno = ENOSYS;
	return -1;
}

ssize_t write(int fd, const void *buf, size_t count)
{
	errno = ENOSYS;
	return -1;
}

off_t lseek(int fd, off_t offset, int whence)
{
	errno = ENOSYS;
	return -1;
}

int rename(const char *old, const char *new)
{
	errno = ENOSYS;
	return -1;
}

int unlink(const char *path)
{
	errno = ENOSYS;
	return -1;
}

long times(void *buf)
{
	errno = ENOSYS;
	return -1;
}
```
