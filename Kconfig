## Kconfig
```kconfig
# Copyright (c) 2024 O.S. Systems Software LTDA.
# Copyright (c) 2024 Freedom Veiculos Eletricos
# SPDX-License-Identifier: Apache-2.0

rsource "subsys/Kconfig"
```

## samples/subsys/zephyrbt/subtree_reuse/sample.yaml
```yaml
# Copyright (c) 2026 O.S. Systems Software LTDA.
# Copyright (c) 2026 Freedom Veiculos Eletricos
# SPDX-License-Identifier: Apache-2.0

sample:
  name: Zephyr Behaviour Tree - Subtree Reuse (Issue #28)
  description: |
    This sample validates correct traversal when a subtree is used multiple
    times in the same behavior tree. It reproduces the scenario from issue #28
    where incorrect indices caused nodes to be skipped during execution.
common:
  tags: zephyrbt
tests:
  samples.zephyrbt.subtree_reuse:
    platform_allow:
      - qemu_cortex_m3
      - nucleo_f767zi
    harness: console
    harness_config:
      type: multi_line
      regex:
        - "D: tick"
        - "D: eval sequence \\[control, 4\\]"
        - "D: Deep: 1"
        - "D: sequence \\[control, 4\\]"
        - "D: eval sub \\[action, 3\\]"
        - "D: Deep: 2"
        - "D: zephyrbt_action_sub stub function"
        - "D: eval a \\[action, 2\\]"
        - "D: Deep: 2"
        - "D: zephyrbt_action_a stub function"
        - "D: eval sub \\[action, 1\\]"
        - "D: Deep: 2"
        - "D: zephyrbt_action_sub stub function"
        - "D: eval b \\[action, 0\\]"
        - "D: Deep: 2"
        - "D: zephyrbt_action_b stub function"
```

## subsys/Kconfig
```kconfig
# Copyright (c) 2024 O.S. Systems Software LTDA.
# Copyright (c) 2024 Freedom Veiculos Eletricos
# SPDX-License-Identifier: Apache-2.0

menu "Subsystems and OS Services"

rsource "zephyrbt/Kconfig"

endmenu
```

## subsys/zephyrbt/Kconfig
```kconfig
# Copyright (c) 2024-2025 O.S. Systems Software LTDA.
# Copyright (c) 2024-2025 Freedom Veiculos Eletricos
# SPDX-License-Identifier: Apache-2.0

config ZEPHYR_BEHAVIOUR_TREE
	bool "Behaviour Tree"

if ZEPHYR_BEHAVIOUR_TREE

config ZEPHYR_BEHAVIOUR_TREE_INIT_PRIORITY
	int "Behaviour Initialization Priority"
	range 0 99
	default 60

config ZEPHYR_BEHAVIOUR_TREE_NODE_INFO
	bool "Include the node information"
	help
	  The node information is only relevant for debug purposes and should
	  not be available when in release mode.

config ZEPHYR_BEHAVIOUR_TREE_USER_DATA
	bool "Include a field to allow user add custom data on the tree"
	help
	  The node information is only relevant for debug purposes and should
	  not be available when in release mode.

config ZEPHYR_BEHAVIOUR_TREE_DYNAMIC
	bool "Enable dynamic behaviour"
	depends on DYNAMIC_THREAD
	depends on KERNEL_MEM_POOL
	help
	  Enable use of dynamic memory.

config ZEPHYR_BEHAVIOUR_TREE_ALLOW_YIELD
	bool "Automatically yield on each turn"
	depends on ZEPHYR_BEHAVIOUR_TREE_DYNAMIC
	default y
	help
	  The behaviour tree will check to call k_yield() to give opportunity
	  to same threads to execute. This do not affect the time slice
	  configuration and both can be used.

	  The time slice can be useful when a very long action may block tree
	  walk. To enable time slice make sure that behaviour tree priority is
	  greater than TIMESLICE_PRIORITY and TIMESLICING=y.

	  If you want to have best walk performace you should disable this
	  option. If you do that you can have side effects like starvation and
	  may not attend all interrupts depending of the priority you select.

	  If you do not know what you are configuring leave as is.

config ZEPHYR_BEHAVIOUR_TREE_NODE_INIT
	bool "Generate node initialization function"
	depends on ZEPHYR_BEHAVIOUR_TREE_DYNAMIC
	help
	  The node initialization function must be defined and will be called
	  at behaviour tree thread initialization.

config ZEPHYR_BEHAVIOUR_TREE_NODE_CONTEXT
	bool "Generate node context storage"
	depends on ZEPHYR_BEHAVIOUR_TREE_NODE_INIT
	help
	  The node context storage functions are available to user when the
	  node initialization is available.

module = ZEPHYR_BEHAVIOUR_TREE
module-str = Behaviour Tree
source "subsys/logging/Kconfig.template.log_config"

endif
```
